// Overriding the device tree of the underlying zephyr
// nrf52dk_nrf52832 board.

// Increase uart0 speed from the 115200 default to 230400
&uart0 {
	status = "okay";
	compatible = "nordic,nrf-uarte";
	current-speed = <115200>;
	tx-pin = <6>;
	rx-pin = <8>;
};